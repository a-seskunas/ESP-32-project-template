## source/mqtt_ex/main/Kconfig.projbuild
```kconfig
menu "Application settings"

    config MQTT_BROKER_IP
        string "IP of the MQTT broker to connect to"
        default "192.168.1.173"
        help
            The local network IP of the machine where you run MQTT broker

    config MQTT_PORT
        int "Port of the MQTT broker in use"
        default 1883
        help
            In general, port 1883 is for plaintext MQTT connections (no encryption).
endmenu
```
